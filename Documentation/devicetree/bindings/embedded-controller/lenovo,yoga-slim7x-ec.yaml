## arch/riscv/Kconfig.erratas
```kconfig
menu "CPU errata selection"

config RISCV_ERRATA_ALTERNATIVE
	bool "RISC-V alternative scheme"
	default y
	help
	  This Kconfig allows the kernel to automatically patch the
	  errata required by the execution platform at run time. The
	  code patching is performed once in the boot stages. It means
	  that the overhead from this mechanism is just taken once.

config CPU_SIFIVE
	bool "SiFive cores"
	help
	  This enables support for SiFive CPU cores. Currently, It will enable
	  all the SiFive errata Kconfig. Please say "Y" here if your platform
	  uses SiFive CPU cores.

	  Otherwise, please say "N" here to avoid unnecessary performance
	  overhead.

config ERRATA_SIFIVE_CIP_453
	bool "Apply SiFive errata CIP-453"
	depends on CPU_SIFIVE
	depends on RISCV_ERRATA_ALTERNATIVE
	default y
	help
	  This will apply the SiFive CIP-453 errata to add sign extension
	  to the $badaddr when exception type is instruction page fault
	  and instruction access fault.

	  If you don't know what to do here, say "Y".

endmenu
```

## drivers/media/pci/intel/Kconfig
```kconfig
config VIDEO_INTEL_IPU
	tristate "Intel IPU driver"
	depends on ACPI
	depends on MEDIA_SUPPORT
	depends on MEDIA_PCI_SUPPORT
	select IOMMU_API
	select IOMMU_IOVA
	select X86_DEV_DMA_OPS if X86
	select VIDEOBUF2_DMA_CONTIG
	select V4L2_FWNODE
	select PHYS_ADDR_T_64BIT
	select COMMON_CLK
	help
	  This is the Intel imaging processing unit, found in Intel SoCs and
	  used for capturing images and video from a camera sensor.

	  To compile this driver, say Y here!

choice
	prompt "intel ipu generation type"
	depends on VIDEO_INTEL_IPU
	default VIDEO_INTEL_IPU6

config VIDEO_INTEL_IPU6
	bool "Compile for IPU6 driver"
	help
	  Sixth generation Intel imaging processing unit found in Intel
	  SoCs.

	  To compile this driver, say Y here!
endchoice

config VIDEO_INTEL_IPU_TPG
	bool "Compile for TPG driver"
	help
	  If selected, TPG device nodes would be created.

	  Recommended for driver developers only.

	  If you want to the TPG devices exposed to user as media entity,
	  you must select this option, otherwise no.

config VIDEO_INTEL_IPU_WERROR
	bool "Force GCC to throw an error instead of a warning when compiling"
	depends on VIDEO_INTEL_IPU
	depends on EXPERT
	depends on !COMPILE_TEST
	default n
	help
	  Add -Werror to the build flags for (and only for) intel ipu module.
	  Do not enable this unless you are writing code for the ipu module.

	  Recommended for driver developers only.

	  If in doubt, say "N".

source "drivers/media/pci/intel/ipu3/Kconfig"
```

## drivers/media/platform/amd/isp4/Kconfig
```kconfig
# SPDX-License-Identifier: GPL-2.0+

config AMD_ISP4
	tristate "AMD ISP4 and camera driver"
	depends on VIDEO_DEV && VIDEO_V4L2_SUBDEV_API
	select VIDEOBUF2_CORE
	select VIDEOBUF2_V4L2
	select VIDEOBUF2_MEMOPS
	help
	  This is support for AMD ISP4 and camera subsystem driver.
	  Say Y here to enable the ISP4 and camera device for video capture.
	  To compile this driver as a module, choose M here. The module will
	  be called amd_capture.
```

## drivers/misc/xgene/qmtm/Kconfig
```kconfig
config XGENE_QMTM
	tristate "APM X-Gene Queue Manager/Traffic Manager driver"
	depends on ARM64 || COMPILE_TEST
	default y
	help
	  This option enables APM X-Gene Queue Manager Traffic Manager (QMTM)
	  driver support.
	  QMTM is required for Ethernet, PktDMA (XOR Engine) and Security
	  Engine.
```

## drivers/net/dpa/NetCommSw/Kconfig
```kconfig
menu "Frame Manager support"

menuconfig FSL_FMAN
	bool "Freescale Frame Manager (datapath) support"
	# depends on PPC_E500MC
	default y
	---help---
		If unsure, say Y.

if FSL_FMAN

config FSL_FMAN_TEST
	bool "FMan test module"
	default n
	---help---
		This option compiles test code for FMan.

menu "FMAN Processor support"
choice
	depends on FSL_FMAN
	prompt "Processor Type"

config FMAN_P3040_P4080_P5020
	bool "P3040 P4080 5020"

config FMAN_P1023
	bool "P1023"

endchoice
endmenu

config FMAN_RESOURCE_ALLOCATION_ALGORITHM
	bool "Enable FMan dynamic resource allocation algorithm"
	default n
	---help---
		Enables algorithm for dynamic resource allocation

config FMAN_DISABLE_OH_TO_REUSE_RESOURCES
	depends on FMAN_RESOURCE_ALLOCATION_ALGORITHM
	bool "Disable offline parsing ports to reuse resources"
	default n
	---help---
		Redistributes FMan OH's resources to all other ports,
		thus enabling other configurations.

config FMAN_MIB_CNT_OVF_IRQ_EN
	bool "Enable the dTSEC MIB counters overflow interrupt"
	default n
	---help---
		Enable the dTSEC MIB counters overflow interrupt to get
		accurate MIB counters values. Enabled it compensates
		for the counters overflow but reduces performance and
		triggers error messages in HV setups.

endif # FSL_FMAN

endmenu
```

## drivers/net/ethernet/apm/xgene/Kconfig
```kconfig
config NET_XGENE
	tristate "APM X-Gene Ethernet Driver"
	depends on XGENE_QMTM
	select PHYLIB
	default y
	help
	  This is the Ethernet driver for APM X-Gene SoC.

	  To compile this driver as a module, choose M here. This module will
	  be called xgene_enet.
```

## drivers/net/wireless/8192cu/Kconfig
```kconfig
config 8192CU
	tristate "Realtek 8192C USB WiFi"
	depends on USB
	depends on CFG80211_WEXT
	---help---
	  Help message of 8192CU
```

## drivers/net/wireless/rtl8192cu/Kconfig
```kconfig
config 8192CU
	tristate "Realtek 8192C USB WiFi"
	depends on USB
	depends on CFG80211_WEXT
	select WIRELESS_EXT
	---help---
	  Help message of RTL8192CU
```

## drivers/net/wireless/rtl8192cu_v40/Kconfig
```kconfig
config RTL8192CU_V40
	tristate "Realtek 8192C USB WiFi Version 20130911(V4.0)"
	depends on USB
	---help---
	  Help message of RTL8192CU(New Version)
```

## drivers/net/wireless/rtl88x2be/Kconfig
```kconfig
config RTL8822BE
	tristate "Realtek 8822B PCIE WiFi"
	depends on PCIE
	---help---
	  Help message of RTL8822BE
```

## drivers/net/wireless/rtlwifi_vendor/Kconfig
```kconfig
config RTL8822BE
	tristate "Realtek RTL8822BE Wireless Network Adapter"
	depends on PCI
	select RTLWIFI_VENDOR
	select RTLWIFI_VENDOR_PCI
	select RTL_VENDOR_BTCOEXIST
	select RTLHALMAC
	select RTLPHYDM
	---help---
	This is the driver for Realtek RTL8822BE 802.11ac PCIe
	wireless network adapters.

	If you choose to build it as a module, it will be called rtl8822be

config RTLWIFI_VENDOR
	tristate
	select FW_LOADER

config RTLWIFI_VENDOR_PCI
	tristate

config RTLWIFI_VENDOR_USB
	tristate

config RTL_VENDOR_BTCOEXIST
	tristate
	depends on RTL8822BE
	default y

config RTLHALMAC
	tristate
	depends on RTL8822BE
	default y

config RTLPHYDM
	tristate
	depends on RTL8822BE
	default y
```

## drivers/scsi/ampe_stor/Kconfig
```kconfig
config SCSI_AMPE_STOR
	tristate "Alcor Micro AU6601/AU6621 card reader"
	depends on PCI
	---help---
	  This driver supports Alcor Micro card readers
```

## drivers/staging/fsl_pme2/Kconfig
```kconfig
config FSL_PME2
	bool "Freescale Datapath Pattern Matcher support"
	depends on HAS_FSL_PME && FSL_QMAN_PORTAL
	default y

menu "Freescale Datapath PME options"
	depends on FSL_PME2

config FSL_PME2_CTRL
	bool "Freescale PME2 (p4080, etc) device control"
	default y
	---help---
	  This compiles device support for the Freescale PME2 pattern matching
	  part contained in datapath-enabled SoCs (ie. accessed via Qman and
	  Bman portal functionality). At least one guest operating system must
	  have this driver support, together with the appropriate device-tree
	  entry, for PME2 functionality to be available. It is responsible for
	  allocating system memory to the device and configuring it for
	  operation. For this reason, it must be built into the kernel and will
	  initialise during early kernel boot.

config FSL_PME2_PDSRSIZE
	int "Pattern Description and Stateful Rule default table size"
	depends on FSL_PME2_CTRL
	range 74240 1048573
	default 131072
	help
	  Select the default size of the Pattern Description and Stateful Rule
	  table as the number of 128 byte entries. This only takes effect if
	  the device tree node doesn't have the 'fsl,pme-pdsr' property.
	  range 74240-1048573 (9.5MB-134MB)
	  default 131072 (16MB)

if FSL_PME2_CTRL
comment "Statefule Rule Engine"
endif

config FSL_PME2_SRESIZE
	int "SRE Session Context Entries table default table size"
	depends on FSL_PME2_CTRL
	range 0 134217727
	default 327680
	help
	  Select the default size of the SRE Context Table as the number of 32
	  byte entries. This only takes effect if the device tree node doesn't
	  have the 'fsl,pme-sre' property.
	  range 0-134217727 (0-4GB)
	  default 327680 (10MB)

config FSL_PME2_SRE_AIM
	bool "Alternate Inconclusive Mode"
	depends on FSL_PME2_CTRL
	default n
	help
	  Select the inconclusive match mode treatment. When true the
	  “alternate” inconclusive mode is used. When false the “default”
	  inconclusive mode is used.

config FSL_PME2_SRE_ESR
	bool "End of SUI Simple Report"
	depends on FSL_PME2_CTRL
	default n
	help
	  Select if an End of SUI will produce a Simple End of SUI report.

config FSL_PME2_SRE_CTX_SIZE_PER_SESSION
	int "Default SRE Context Size per Session (16 => 64KB, 17 => 128KB)"
	depends on FSL_PME2_CTRL
	range 5 17
	default 17
	help
	  Select SRE context size per session as a power of 2.
	  range 5-17
	  Examples:
	             5  => 32 B
	             6  => 64 B
	             7  => 128 B
	             8  => 256 B
	             9  => 512 B
	             10 => 1 KB
	             11 => 2 KB
	             12 => 4 KB
	             13 => 8 KB
	             14 => 16 KB
	             15 => 32 KB
	             16 => 64 KB
	             17 => 128 KB

config FSL_PME2_SRE_CNR
	int "Configured Number of Stateful Rules as a multiple of 256 (128 => 32768 )"
	depends on FSL_PME2_CTRL
	range 0 128
	default 128
	help
	  Select number of stateful rules as a multiple of 256.
	  range 0-128
	  Examples:
	             0  => 0
	             1  => 256
	             2  => 512
	             ...
	             127 => 32512
	             128 => 32768

config FSL_PME2_SRE_MAX_INSTRUCTION_LIMIT
	int "Maximum number of SRE instructions to be executed per reaction."
	depends on FSL_PME2_CTRL
	range 0 65535
	default 65535
	help
	  Select the maximum number of SRE instructions to be executed per
	  reaction.
	  range 0 65535

config FSL_PME2_SRE_MAX_BLOCK_NUMBER
	int "Maximum number of Reaction Head blocks to be traversed per pattern match event"
	depends on FSL_PME2_CTRL
	range 0 32767
	default 32767
	help
	  Select the maximum number of reaction head blocks to be traversed per
	  pattern match event (e.g. a matched pattern or an End of SUI event).
	  range 0-32767

config FSL_PME2_PORTAL
	tristate "Freescale PME2 (p4080, etc) device usage"
	default y
	---help---
	  This compiles I/O support for the Freescale PME2 pattern matching
	  part contained in datapath-enabled SoCs (ie. accessed via Qman and
	  Bman portal functionality).

if FSL_PME2_PORTAL

config FSL_PME2_TEST_HIGH
	tristate "PME2 high-level self-test"
	default n
	---help---
	  This uses the high-level Qman driver (and the cpu-affine portals it
	  manages) to perform high-level PME2 API testing with it.

config FSL_PME2_TEST_SCAN
	tristate "PME2 scan self-test"
	default n
	---help---
	  This uses the high-level Qman driver (and the cpu-affine portals it
	  manages) to perform scan PME2 API testing with it.

config FSL_PME2_TEST_SCAN_WITH_BPID
	bool "PME2 scan self-test with buffer pool"
	depends on FSL_PME2_TEST_SCAN && FSL_BMAN_PORTAL
	default y
	---help---
	  This uses a buffer pool id for scan test

config FSL_PME2_TEST_SCAN_WITH_BPID_SIZE
	int "Buffer Pool size."
	depends on FSL_PME2_TEST_SCAN_WITH_BPID
	range 0 11
	default 3
	---help---
	  This uses the specified buffer pool size.

config FSL_PME2_DB
	tristate "PME2 Database support"
	depends on FSL_PME2_CTRL
	default y
	---help---
	  This compiles the database driver for PME2.

config FSL_PME2_DB_QOSOUT_PRIORITY
	int "PME DB output frame queue priority."
	depends on FSL_PME2_DB
	range 0 7
	default 2
	---help---
	  The PME DB has a scheduled output frame queue. The qos priority level is configurable.
	  range 0-7
		0 => High Priority 0
		1 => High Priority 1
		2 => Medium Priority
		3 => Medium Priority
		4 => Medium Priority
		5 => Low Priority
		6 => Low Priority
		7 => Low Priority

config FSL_PME2_SCAN
        tristate "PME2 Scan support"
        default y
        ---help---
          This compiles the scan driver for PME2.

config FSL_PME2_SCAN_DEBUG
        bool "Debug Statements"
        default n
        depends on FSL_PME2_SCAN
        ---help---
          The PME2_SCAN driver can optionally trace with more verbosity
          of verbosity.

endif

config FSL_PME2_STAT_ACCUMULATOR_UPDATE_INTERVAL
	int "Configure the pme2 statistics update interval in milliseconds"
	depends on FSL_PME2_CTRL
	range 0 10000
	default 3400
	help
	  The pme accumulator reads the current device statistics and add it
	  to a running counter. The frequency of these updates may be
	  controlled. If 0 is specified, no automatic updates is done.
	  range 0-10000

endmenu
```
