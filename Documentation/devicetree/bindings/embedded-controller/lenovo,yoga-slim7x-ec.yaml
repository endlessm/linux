## Documentation/devicetree/bindings/embedded-controller/lenovo,yoga-slim7x-ec.yaml
```yaml
# SPDX-License-Identifier: (GPL-2.0-only OR BSD-2-Clause)
%YAML 1.2
---
$id: http://devicetree.org/schemas/platform/lenovo,yoga-slim7x-ec.yaml#
$schema: http://devicetree.org/meta-schemas/core.yaml#

title: Lenovo Yoga Slim 7x Embedded Controller.

maintainers:
  - Maya Matuszczyk <maccraft123mc@gmail.com>

description:
  The Lenovo Yoga Slim 7x has an EC which handles some minor functions, like
  power LED or some special keys on the keyboard. This bindings describes
  how it is connected

properties:
  compatible:
    const: lenovo,yoga-slim7x-ec

  reg:
    const: 0x76

  interrupts:
    maxItems: 1

required:
  - compatible
  - reg
  - interrupts

additionalProperties: false

examples:
  - |+
    #include <dt-bindings/interrupt-controller/irq.h>
    i2c5 {
        clock-frequency = <400000>;

        #address-cells = <1>;
        #size-cells = <0>;

        embedded-controller@76 {
            compatible = "lenovo,yoga-slim7x-ec";
            reg = <0x76>;

            interrupts-extended = <&tlmm 66 IRQ_TYPE_LEVEL_HIGH>;
        };
    };
...
```

## Documentation/devicetree/bindings/media/qcom,sm8350-venus.yaml
```yaml
# SPDX-License-Identifier: (GPL-2.0 OR BSD-2-Clause)
%YAML 1.2
---
$id: http://devicetree.org/schemas/media/qcom,sm8350-venus.yaml#
$schema: http://devicetree.org/meta-schemas/core.yaml#

title: Qualcomm SM8350 Venus video encode and decode accelerators

maintainers:
  - Konrad Dybcio <konradybcio@kernel.org>

description: |
  The Venus Iris2 IP is a video encode and decode accelerator present
  on Qualcomm platforms

allOf:
  - $ref: qcom,venus-common.yaml#

properties:
  compatible:
    enum:
      - qcom,sc8280xp-venus
      - qcom,sm8350-venus

  clocks:
    maxItems: 3

  clock-names:
    items:
      - const: iface
      - const: core
      - const: vcodec0_core

  resets:
    maxItems: 1

  reset-names:
    items:
      - const: core

  power-domains:
    maxItems: 3

  power-domain-names:
    items:
      - const: venus
      - const: vcodec0
      - const: mx

  interconnects:
    maxItems: 3

  interconnect-names:
    items:
      - const: cpu-cfg
      - const: video-mem
      - const: video-llcc

  operating-points-v2: true
  opp-table:
    type: object

  iommus:
    maxItems: 1

  video-decoder:
    type: object

    properties:
      compatible:
        const: venus-decoder

    required:
      - compatible

    additionalProperties: false

  video-encoder:
    type: object

    properties:
      compatible:
        const: venus-encoder

    required:
      - compatible

    additionalProperties: false

required:
  - compatible
  - power-domain-names
  - iommus
  - video-decoder
  - video-encoder

unevaluatedProperties: false

examples:
  - |
    #include <dt-bindings/interrupt-controller/arm-gic.h>
    #include <dt-bindings/clock/qcom,gcc-sm8350.h>
    #include <dt-bindings/clock/qcom,sm8350-videocc.h>
    #include <dt-bindings/interconnect/qcom,sm8350.h>
    #include <dt-bindings/power/qcom-rpmpd.h>

    venus: video-codec@aa00000 {
        compatible = "qcom,sm8350-venus";
        reg = <0x0aa00000 0x100000>;
        interrupts = <GIC_SPI 174 IRQ_TYPE_LEVEL_HIGH>;

        clocks = <&gcc GCC_VIDEO_AXI0_CLK>,
                 <&videocc VIDEO_CC_MVS0C_CLK>,
                 <&videocc VIDEO_CC_MVS0_CLK>;
        clock-names = "iface",
                      "core",
                      "vcodec0_core";

        resets = <&gcc GCC_VIDEO_AXI0_CLK_ARES>;
        reset-names = "core";

        power-domains = <&videocc MVS0C_GDSC>,
                        <&videocc MVS0_GDSC>,
                        <&rpmhpd SM8350_MX>;
        power-domain-names = "venus",
                             "vcodec0",
                             "mx";

        interconnects = <&gem_noc MASTER_APPSS_PROC 0 &config_noc SLAVE_VENUS_CFG 0>,
                        <&mmss_noc MASTER_VIDEO_P0 0 &mc_virt SLAVE_EBI1 0>,
                        <&mmss_noc MASTER_VIDEO_P0 0 &gem_noc SLAVE_LLCC 0>;
        interconnect-names = "cpu-cfg",
                             "video-mem",
                             "video-llcc";

        operating-points-v2 = <&venus_opp_table>;
        iommus = <&apps_smmu 0x2100 0x400>;
        memory-region = <&pil_video_mem>;

        status = "disabled";

        video-decoder {
            compatible = "venus-decoder";
        };

        video-encoder {
            compatible = "venus-encoder";
        };
    };
```

## Documentation/devicetree/bindings/misc/apm-xgene-qmtm.txt
```
* APM X-Gene SoC Queue Manager/Traffic Manager nodes

QMTM nodes are defined to describe on-chip Queue Managers in APM X-Gene SoC.
APM X-Gene SoC Ethernet, PktDMA (XOR Engine), and Security Engine subsystems
communicate with a central Queue Manager using messages which include
information about the work to be performed and the location of the associated
data buffers. There are multiple instances of QMTM. Each QMTM instance has its
own node. Its corresponding clock nodes are shown below.

Required properties:
- compatible		: Shall be "apm,xgene-qmtm-lite" for QMLite instance
- reg			: First memory resource shall be the QMTM CSR memory
			  resource.
			  Second memory resource shall be the QMTM IO-Fabric
			  memory resource.
- slave-name		: Shall be "CPU_QMTM3" which is receiver for ingress
			  work messages for the QMTM. Here receiver is CPU.
- interrupts		: First interrupt resource shall be the QMTM Error
			  interrupt.
			  Remaining interrupt resources shall be the Ingress
			  work message interrupt mapping for receiver,
			  receiving work messages for the QMTM.
- clocks		: Reference to the clock entry.

Optional properties:
- status		: Shall be "ok" if enabled or "disabled" if disabled.
			  Default is "ok".

Example:
		qmlclk: qmlclk {
			compatible = "apm,xgene-device-clock";
			#clock-cells = <1>;
			clock-names = "socplldiv2";
			status = "ok";
			csr-offset = <0x0>;
			csr-mask = <0x3>;
			enable-offset = <0x8>;
			enable-mask = <0x3>;
		};

		qmlite: qmtm@17030000 {
			compatible = "apm,xgene-qmtm-lite";
			reg = <0x0 0x17030000 0x0 0x10000>,
			      <0x0 0x10000000 0x0 0x400000>;
			slave-name = "CPU_QMTM3";
			interrupts = <0x0 0x40 0x4>,
				     <0x0 0x3c 0x4>;
			status = "ok";
			#clock-cells = <1>;
			clocks = <&qmlclk 0>;
		};
```

## Documentation/devicetree/bindings/net/apm-xgene-enet.txt
```
APM X-Gene SoC Ethernet nodes

Ethernet nodes are defined to describe on-chip ethernet interfaces in
APM X-Gene SoC. Ethernet subsystem communicates with a central Queue Manager
(QMTM) using messages for transmit, receive and allocating data buffers.
There are multiple ethernet interfaces in APM X-Gene SoC. Each ethernet
interface has its own node. Its corresponding clock nodes are shown below.

Required properties:
- compatible		: Shall be "apm,xgene-enet"
- reg			: First memory resource shall be the Ethernet CSR
			  memory resource for indirect MAC access.
			  Second memory resource shall be the Ethernet CSR
			  memory resource.
			  Third memory resource shall be the Ethernet CSR
			  memory resource for indirect MII access.
- slave-name		: Shall be QMTM slave name.
- interrupts		: First interrupt resource shall be the Ethernet global
			  Error interrupt.
			: Second interrupt resource shall be the Ethernet MAC
			  Error interrupt.
			: Third interrupt resource shall be the Ethernet QM
			  interface interrupt.
- clocks		: Reference to the clock entry.
- local-mac-address	: Shall be ethernet mac address.
- max-frame-size	: Shall be maximum ethernet frame size.
- devid			: Shall be ethernet interface number.
- phyid			: Shall be ethernet MII phy address.
- phy-mode		: Shall be ethernet MII mode.

Optional properties:
- status		: Shall be "ok" if enabled or "disabled" if disabled.
			  Default is "ok".

Example:
	eth8clk: eth8clk {
		compatible = "apm,xgene-device-clock";
		clock-names = "eth8clk";
		status = "ok";
	};

	menet: ethernet@17020000 {
		compatible = "apm,xgene-enet";
		status = "disabled";
		reg = <0x0 0x17020000 0x0 0x30>,
		      <0x0 0x17020000 0x0 0x10000>,
		      <0x0 0x17020000 0x0 0x20>;
		slave-name = "RGMII";
		interrupts = <0x0 0x38 0x4>,
			     <0x0 0x39 0x4>,
			     <0x0 0x3a 0x4>;
		clocks = <&eth8clk 0>;
		local-mac-address = <0x0 0x11 0x3a 0x8a 0x5a 0x78>;
		max-frame-size = <0x233a>;
		devid = <8>;
		phyid = <3>;
		phy-mode = "rgmii";
	};

/* Board-specific peripheral configurations */
aliases {
	ethernet0 = &menet;
};

&menet {
        status = "ok";
};
```

## Documentation/devicetree/bindings/pci/sifive,fu740-pcie.yaml
```yaml
# SPDX-License-Identifier: (GPL-2.0-only OR BSD-2-Clause)
%YAML 1.2
---
$id: http://devicetree.org/schemas/pci/sifive,fu740-pcie.yaml#
$schema: http://devicetree.org/meta-schemas/core.yaml#

title: SiFive fu740 PCIe host controller

description: |
  SiFive fu740 PCIe host controller is based on the Synopsys DesignWare
  PCI core. It shares common features with the PCIe DesignWare core and
  inherits common properties defined in
  Documentation/devicetree/bindings/pci/designware-pcie.txt.

maintainers:
  - Paul Walmsley <paul.walmsley@sifive.com>
  - Greentime Hu <greentime.hu@sifive.com>

allOf:
  - $ref: /schemas/pci/pci-bus.yaml#

properties:
  compatible:
    const: sifive,fu740-pcie

  reg:
    maxItems: 4

  reg-names:
    items:
      - const: dbi
      - const: config
      - const: mgmt

  device_type:
    const: pci

  dma-coherent:
    description: Indicates that the PCIe IP block can ensure the coherency

  bus-range:
    description: Range of bus numbers associated with this controller.

  num-lanes: true

  msi-parent: true

  interrupt-names:
    items:
      - const: msi
      - const: inta
      - const: intb
      - const: intc
      - const: intd

  resets:
    description: A phandle to the PCIe power up reset line

  pwren-gpios:
    description: Should specify the GPIO for controlling the PCI bus device power on

  perstn-gpios:
    description: Should specify the GPIO for controlling the PCI bus device reset

required:
  - compatible
  - reg
  - reg-names
  - device_type
  - dma-coherent
  - bus-range
  - ranges
  - num-lanes
  - interrupts
  - interrupt-names
  - interrupt-parent
  - interrupt-map-mask
  - interrupt-map
  - clock-names
  - clocks
  - resets
  - pwren-gpios
  - perstn-gpios

additionalProperties: false

examples:
  - |
    pcie@e00000000 {
        #address-cells = <3>;
        #interrupt-cells = <1>;
        #size-cells = <2>;
        compatible = "sifive,fu740-pcie";
        reg = <0xe 0x00000000 0x1 0x0
               0xd 0xf0000000 0x0 0x10000000
               0x0 0x100d0000 0x0 0x1000>;
        reg-names = "dbi", "config", "mgmt";
        device_type = "pci";
        dma-coherent;
        bus-range = <0x0 0xff>;
        ranges = <0x81000000  0x0 0x60080000  0x0 0x60080000 0x0 0x10000        /* I/O */
                  0x82000000  0x0 0x60090000  0x0 0x60090000 0x0 0xff70000      /* mem */
                  0x82000000  0x0 0x70000000  0x0 0x70000000 0x0 0x1000000      /* mem */
                  0xc3000000 0x20 0x00000000 0x20 0x00000000 0x20 0x00000000>;  /* mem prefetchable */
        num-lanes = <0x8>;
        interrupts = <56 57 58 59 60 61 62 63 64>;
        interrupt-names = "msi", "inta", "intb", "intc", "intd";
        interrupt-parent = <&plic0>;
        interrupt-map-mask = <0x0 0x0 0x0 0x7>;
        interrupt-map = <0x0 0x0 0x0 0x1 &plic0 57>,
                        <0x0 0x0 0x0 0x2 &plic0 58>,
                        <0x0 0x0 0x0 0x3 &plic0 59>,
                        <0x0 0x0 0x0 0x4 &plic0 60>;
	clock-names = "pcie_aux";
        clocks = <&prci PRCI_CLK_PCIE_AUX>;
        resets = <&prci 4>;
        pwren-gpios = <&gpio 5 0>;
        perstn-gpios = <&gpio 8 0>;
    };
```

## Documentation/devicetree/bindings/phy/qcom,x1e80100-csi2-phy.yaml
```yaml
# SPDX-License-Identifier: (GPL-2.0 OR BSD-2-Clause)
%YAML 1.2
---
$id: http://devicetree.org/schemas/phy/qcom,x1e80100-csi2-phy.yaml#
$schema: http://devicetree.org/meta-schemas/core.yaml#

title: Qualcomm CSI2 PHY

maintainers:
  - Bryan O'Donoghue <bod@kernel.org>

description:
  Qualcomm MIPI CSI2 C-PHY/D-PHY combination PHY. Connects MIPI CSI2 sensors
  to Qualcomm's Camera CSI Decoder. The PHY supports both C-PHY and D-PHY
  modes.

properties:
  compatible:
    const: qcom,x1e80100-csi2-phy

  reg:
    maxItems: 1

  "#phy-cells":
    const: 1

  clocks:
    maxItems: 4

  clock-names:
    items:
      - const: csiphy
      - const: csiphy_timer
      - const: camnoc_axi
      - const: cpas_ahb

  interrupts:
    maxItems: 1

  operating-points-v2:
    maxItems: 1

  power-domains:
    items:
      - description: TITAN TOP GDSC
      - description: MXC or MXA voltage rail
      - description: MMCX voltage rail

  power-domain-names:
    items:
      - const: top
      - const: mx
      - const: mmcx

  vdda-0p8-supply:
    description: Phandle to a 0.8V regulator supply to a PHY.

  vdda-1p2-supply:
    description: Phandle to 1.2V regulator supply to a PHY.

required:
  - compatible
  - reg
  - "#phy-cells"
  - clocks
  - clock-names
  - interrupts
  - operating-points-v2
  - power-domains
  - power-domain-names
  - vdda-0p8-supply
  - vdda-1p2-supply

additionalProperties: false

examples:
  - |
    #include <dt-bindings/interrupt-controller/arm-gic.h>
    #include <dt-bindings/clock/qcom,x1e80100-camcc.h>
    #include <dt-bindings/clock/qcom,x1e80100-gcc.h>
    #include <dt-bindings/phy/phy.h>
    #include <dt-bindings/power/qcom,rpmhpd.h>

    csiphy@ace4000 {
        compatible = "qcom,x1e80100-csi2-phy";
        reg = <0x0ace4000 0x2000>;
        #phy-cells = <1>;

        clocks = <&camcc CAM_CC_CSIPHY0_CLK>,
                 <&camcc CAM_CC_CSI0PHYTIMER_CLK>,
                 <&camcc CAM_CC_CAMNOC_AXI_RT_CLK>,
                 <&camcc CAM_CC_CPAS_AHB_CLK>;
        clock-names = "csiphy",
                      "csiphy_timer",
                      "camnoc_axi",
                      "cpas_ahb";

        operating-points-v2 = <&csiphy_opp_table>;

        interrupts = <GIC_SPI 477 IRQ_TYPE_EDGE_RISING>;

        power-domains = <&camcc CAM_CC_TITAN_TOP_GDSC>,
                        <&rpmhpd RPMHPD_MX>,
                        <&rpmhpd RPMHPD_MMCX>;
        power-domain-names = "top",
                             "mx",
                             "mmcx";

        vdda-0p8-supply = <&vreg_l2c_0p8>;
        vdda-1p2-supply = <&vreg_l1c_1p2>;
    };

    csiphy_opp_table: opp-table {
        compatible = "operating-points-v2";

        opp-300000000 {
            opp-hz = /bits/ 64 <300000000>;
            required-opps = <&rpmhpd_opp_low_svs_d1>,
                            <&rpmhpd_opp_low_svs_d1>;
        };

        opp-400000000 {
            opp-hz = /bits/ 64 <400000000>;
            required-opps = <&rpmhpd_opp_low_svs>,
                            <&rpmhpd_opp_low_svs>;
        };

        opp-480000000 {
            opp-hz = /bits/ 64 <480000000>;
            required-opps = <&rpmhpd_opp_low_svs>,
                            <&rpmhpd_opp_low_svs>;
        };
    };
```
