## ubuntu/igh-ecat/Kconfig
```kconfig
# SPDX-License-Identifier: GPL-2.0-only

menuconfig IGH_ECAT
        tristate "IgH EtherCAT master driver support"
        depends on NET && ETHERNET
        default m
        help
          This section contains options for IgH EtherCAT master support.

if IGH_ECAT

config IGH_ECAT_GENERIC_DEVICE
       tristate "Enable IgH EtherCAT master generic device driver"
       depends on IGH_ECAT

config IGH_ECAT_ENABLE_EOE
        bool "Enable Ethernet over EtherCAT (EoE) support"
        depends on IGH_ECAT
        default y

endif # IGH_ECAT
```

## ubuntu/vbox/Kconfig
```kconfig
config VBOX_GUEST
	bool "VirtualBox guest drivers"
	select DRM_TTM
	default y
	---help---
	Enable VirtualBox guest drivers
```
